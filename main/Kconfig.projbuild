## main/Kconfig.projbuild
```kconfig
menu "Client Configuration"
    menu "ADC CONFIG"

        choice ADC1_CHANNEL
            bool "ADC1 Channel Num"
            default ADC1_CHANNEL_1
            help
                The channel of ADC1 used in this example.

            config ADC1_CHANNEL_0
                bool "ADC1 Channel 0 (GPIO 4)"
            config ADC1_CHANNEL_1
                bool "ADC1 Channel 1 (GPIO 0)"
            config ADC1_CHANNEL_2
                bool "ADC1 Channel 2 (GPIO 2)"
            config ADC1_CHANNEL_3
                bool "ADC1 Channel 3 (GPIO 15)"
            
        endchoice

        config ADC1_CHANNEL
            int
            default 0 if ADC1_CHANNEL_0
            default 1 if ADC1_CHANNEL_1
            default 2 if ADC1_CHANNEL_2
            default 3 if ADC1_CHANNEL_3

    endmenu

    menu "SD CARD CONFIG"

        config FORMAT_IF_MOUNT_FAILED
            bool "Format the card if mount failed"
            default n
            help
                If this config item is set, format_if_mount_failed will be set to true and the card will be formatted if
                the mount has failed.
                
        choice MOSI
            bool "MOSI"
            default ESP32CAM
            help
                MOSI OR DI OR CMD.

            config ESP32CAM
                bool "ESP32CAM GPIO15"
            config ESP32
                bool "ESP32 GPIO13"
        endchoice

        config MOSI
            int 
            default 15 if ESP32CAM
            default 2 if ESP32  
            
        choice MISO
            bool "MISO"
            default ESP32CAM
            help
                MISO OR DO OR DATA0.

            config ESP32CAM
                bool "ESP32CAM GPIO2"
            config ESP32
                bool "ESP32 GPIO4"
        endchoice
        
        config MISO
            int 
            default 2 if ESP32CAM
            default 4 if ESP32   
            
        choice CLK
            bool "CLK"
            default ESP32CAM
            help
                CLK OR SCLK.

            config ESP32CAM
                bool "ESP32CAM GPIO14"
            config ESP32
                bool "ESP32 GPIO14"
        endchoice
            
        config CLK
            int 
            default 14 if ESP32CAM
            default 14 if ESP32   
            
        choice CS
            bool "CS"
            default ESP32CAM
            help
                CS OR DATA3.

            config ESP32CAM
                bool "ESP32CAM GPIO13"
            config ESP32
                bool "ESP32 GPIO15"
        endchoice

        config CS
            int 
            default 13 if ESP32CAM
            default 15 if ESP32   
    endmenu        
    
    menu "HTTP Server Setting"

		config WEB_PORT
			int "HTTP Server Port"
			default 80
			help
				HTTP server port to use.
				
        choice MEDIA_DIR
            bool "sdcard or flash"
            default flash
            help
                choose where you place frontend filed (front directory).

            config sdcard
                bool "read from sdcard"
            config flash
                bool "read from flash"
        endchoice

        config MEDIA_DIR
            string  
            default "/sdcard/front/" if sdcard
            default "/front" if flash		

	endmenu
                
    menu "CAMERA CONFIG"
        choice XCLK_FREQ
            bool "Frequency"
            default 20MHz
            help
                frequency 10MHz or 20MHz.

            config 20MHz
                bool "20MHz"
            config 10MHz
                bool "10MHz"
        endchoice

        config XCLK_FREQ
            int 
            default 20000000 if 20MHz
            default 10000000 if 10MHz
            
        choice FRAMESIZE
            bool "Resolution"
            default QVGA
            help
                Do not use sizes above QVGA when not JPEG.

            config QVGA
                bool "QVGA 320x240"
            config CIF
                bool "CIF 400x296"
            config HVGA
                bool "HVGA 480x320"
            config VGA
                bool "VGA 640x480"  
            config SVGA
                bool "SVGA 800x600"    
            config HD
                bool "HD 1280x720" 
            config UXGA
                bool "UXGA 1600x1200" 
        endchoice

        config FRAMESIZE
            int 
            default 5 if QVGA
            default 6 if CIF 
            default 7 if HVGA
            default 8 if VGA 
            default 9 if SVGA
            default 11 if HD 
            default 13 if UXGA
            
        choice PIXFORMAT
            bool "Image format"
            default JPEG
            help
                image format to save.

            config JPEG
                bool "JPEG"
            config GRAYSCALE
                bool "GRAYSCALE"
            config RAW
                bool "RAW"
            config RGB565
                bool "RGB565"    
        endchoice

        config PIXFORMAT
            int 
            default 3 if JPEG
            default 2 if GRAYSCALE    
            default 5 if RAW
            default 1 if RGB565  
            
        choice PICSPEED
            bool "Camera speed"
            default 5s
            help
                image speed to capture and save.

            config 5s
                bool "5s"
            config 3s
                bool "3s"    
            config 2s
                bool "2s"    
        endchoice

        config PICSPEED
            int 
            default 5000 if 5s
            default 3000 if 3s 
            default 2000 if 2s 
    
                
    endmenu
endmenu
```

## sdkconfig.defaults
```kconfig
# Default sdkconfig parameters to use the OTA
# partition table layout, with a 4MB flash size
CONFIG_ESP32_DEFAULT_CPU_FREQ_240=y
CONFIG_ESP32S2_DEFAULT_CPU_FREQ_240=y
CONFIG_ESP32S3_DEFAULT_CPU_FREQ_240=y

CONFIG_ESPTOOLPY_FLASHSIZE_4MB=y
CONFIG_PARTITION_TABLE_OFFSET=0x10000

CONFIG_FREERTOS_HZ=1000
CONFIG_ESPTOOLPY_FLASHFREQ_80M=y
CONFIG_ESPTOOLPY_FLASHMODE_QIO=y

CONFIG_SPIRAM_SUPPORT=y
CONFIG_ESP32_SPIRAM_SUPPORT=y
CONFIG_ESP32S2_SPIRAM_SUPPORT=y
CONFIG_ESP32S3_SPIRAM_SUPPORT=y
CONFIG_SPIRAM_SPEED_80M=y

CONFIG_MOSI_GPIO=15
CONFIG_MISO_GPIO=13
CONFIG_SCLK_GPIO=2
CONFIG_CE_GPIO=12
CONFIG_CSN_GPIO=33

CONFIG_ESP_MAIN_TASK_STACK_SIZE=4000

CONFIG_ESPTOOLPY_FLASHSIZE_4MB=y
CONFIG_PARTITION_TABLE_CUSTOM=y
CONFIG_APP_PROJECT_VER_FROM_CONFIG=y
CONFIG_BOOTLOADER_APP_ROLLBACK_ENABLE=y
CONFIG_ESP_COREDUMP_ENABLE_TO_FLASH=y
CONFIG_ESP_TLS_CLIENT_SESSION_TICKETS=y
```
